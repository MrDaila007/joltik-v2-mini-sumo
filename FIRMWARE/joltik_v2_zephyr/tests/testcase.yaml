## FIRMWARE/joltik_v2_zephyr/tests/testcase.yaml
```yaml
common:
  tags:
    - joltik
    - sumo
  harness: ztest

tests:
  joltik.unit_tests:
    platform_allow:
      - native_sim
    integration_platforms:
      - native_sim
```
